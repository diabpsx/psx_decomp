/* generated by tools/gen_ld.py: true ROM order, every subsegment pinned to its retail address */
SECTIONS
{
    _gp = 0x8011A780;
    __romPos = 0;
    .pregame 0x80139BF8 : AT(0) SUBALIGN(4)
    {
        . = 0x0;   /* 0x80139BF8 */
        build/asm/data/pregame_hdr.data.s.o(.data);
        . = 0x4;   /* 0x80139BFC */
        build/native_source/pregame.text.s.o(.text);   /* verified native-assembled source */
        . = 0x2C;   /* 0x80139C24 */
        build/native_source/drlg_l1_pool.rodata.s.o(.rodata);   /* verified native source data */
        . = 0x60;   /* 0x80139C58 */
        build/native_source/drlg_l1_tables.data.s.o(.data);   /* verified native source data */
        . = 0x20B8;   /* 0x8013BCB0 */
        build/native_source/drlg_l1.text.s.o(.text);   /* verified native-assembled source */
        . = 0x72FC;   /* 0x80140EF4 */
        build/native_source/drlg_l2.raw_drlg_l2_rodata_80140ef4.rodata.s.o(.rodata);   /* verified native raw span */
        . = 0x7344;   /* 0x80140F3C */
        build/native_source/drlg_l2.raw_drlg_l2_rodata_80140f3c.rodata.s.o(.rodata);   /* verified native raw span */
        . = 0x73E8;   /* 0x80140FE0 */
        build/native_source/drlg_l2.raw_drlg_l2_rodata_80140fe0.rodata.s.o(.rodata);   /* verified native raw span */
        . = 0x748C;   /* 0x80141084 */
        build/native_source/drlg_l2.raw_drlg_l2_rodata_80141084.rodata.s.o(.rodata);   /* verified native raw span */
        . = 0x74A0;   /* 0x80141098 */
        build/native_source/drlg_l2.raw_drlg_l2_rodata_80141098.rodata.s.o(.rodata);   /* verified native raw span */
        . = 0x74B4;   /* 0x801410AC */
        build/native_source/drlg_l2.raw_drlg_l2_rodata_801410ac.rodata.s.o(.rodata);   /* verified native raw span */
        . = 0x74C8;   /* 0x801410C0 */
        build/native_source/drlg_l2.raw_drlg_l2_rodata_801410c0.rodata.s.o(.rodata);   /* verified native raw span */
        . = 0x74DC;   /* 0x801410D4 */
        build/native_source/drlg_l2.raw_drlg_l2_rodata_801410d4.rodata.s.o(.rodata);   /* verified native raw span */
        . = 0x74F0;   /* 0x801410E8 */
        build/native_source/drlg_l2.raw_drlg_l2_rodata_801410e8.rodata.s.o(.rodata);   /* verified native raw span */
        . = 0x7504;   /* 0x801410FC */
        build/native_source/drlg_l2.raw_drlg_l2_rodata_801410fc.rodata.s.o(.rodata);   /* verified native raw span */
        . = 0x7518;   /* 0x80141110 */
        build/native_source/drlg_l2.raw_drlg_l2_rodata_80141110.rodata.s.o(.rodata);   /* verified native raw span */
        . = 0x752C;   /* 0x80141124 */
        build/native_source/drlg_l2.raw_drlg_l2_rodata_80141124.rodata.s.o(.rodata);   /* verified native raw span */
        . = 0x7540;   /* 0x80141138 */
        build/native_source/drlg_l2.raw_drlg_l2_rodata_80141138.rodata.s.o(.rodata);   /* verified native raw span */
        . = 0x7554;   /* 0x8014114C */
        build/native_source/drlg_l2.raw_drlg_l2_rodata_8014114c.rodata.s.o(.rodata);   /* verified native raw span */
        . = 0x7568;   /* 0x80141160 */
        build/native_source/drlg_l2.raw_drlg_l2_rodata_80141160.rodata.s.o(.rodata);   /* verified native raw span */
        . = 0x757C;   /* 0x80141174 */
        build/native_source/drlg_l2.raw_drlg_l2_rodata_80141174.rodata.s.o(.rodata);   /* verified native raw span */
        . = 0x7590;   /* 0x80141188 */
        build/native_source/drlg_l2.raw_drlg_l2_rodata_80141188.rodata.s.o(.rodata);   /* verified native raw span */
        . = 0x75A4;   /* 0x8014119C */
        build/native_source/drlg_l2.raw_drlg_l2_rodata_8014119c.rodata.s.o(.rodata);   /* verified native raw span */
        . = 0x75B8;   /* 0x801411B0 */
        build/native_source/drlg_l2.raw_drlg_l2_rodata_801411b0.rodata.s.o(.rodata);   /* verified native raw span */
        . = 0x75CC;   /* 0x801411C4 */
        build/native_source/drlg_l2.raw_drlg_l2_rodata_801411c4.rodata.s.o(.rodata);   /* verified native raw span */
        . = 0x75DC;   /* 0x801411D4 */
        build/native_source/drlg_l2.raw_drlg_l2_rodata_801411d4.rodata.s.o(.rodata);   /* verified native raw span */
        . = 0x75EC;   /* 0x801411E4 */
        build/native_source/drlg_l2.raw_drlg_l2_rodata_801411e4.rodata.s.o(.rodata);   /* verified native raw span */
        . = 0x75FC;   /* 0x801411F4 */
        build/native_source/drlg_l2.raw_drlg_l2_rodata_801411f4.rodata.s.o(.rodata);   /* verified native raw span */
        . = 0x760C;   /* 0x80141204 */
        build/native_source/drlg_l2.raw_drlg_l2_rodata_80141204.rodata.s.o(.rodata);   /* verified native raw span */
        . = 0x761C;   /* 0x80141214 */
        build/native_source/drlg_l2.raw_drlg_l2_rodata_80141214.rodata.s.o(.rodata);   /* verified native raw span */
        . = 0x762C;   /* 0x80141224 */
        build/native_source/drlg_l2.raw_drlg_l2_rodata_80141224.rodata.s.o(.rodata);   /* verified native raw span */
        . = 0x763C;   /* 0x80141234 */
        build/native_source/drlg_l2.raw_drlg_l2_rodata_80141234.rodata.s.o(.rodata);   /* verified native raw span */
        . = 0x764C;   /* 0x80141244 */
        build/native_source/drlg_l2.raw_drlg_l2_rodata_80141244.rodata.s.o(.rodata);   /* verified native raw span */
        . = 0x7660;   /* 0x80141258 */
        build/native_source/drlg_l2.raw_drlg_l2_rodata_80141258.rodata.s.o(.rodata);   /* verified native raw span */
        . = 0x7674;   /* 0x8014126C */
        build/native_source/drlg_l2.raw_drlg_l2_rodata_8014126c.rodata.s.o(.rodata);   /* verified native raw span */
        . = 0x7688;   /* 0x80141280 */
        build/native_source/drlg_l2.raw_drlg_l2_rodata_80141280.rodata.s.o(.rodata);   /* verified native raw span */
        . = 0x769C;   /* 0x80141294 */
        build/native_source/drlg_l2.raw_drlg_l2_rodata_80141294.rodata.s.o(.rodata);   /* verified native raw span */
        . = 0x76B0;   /* 0x801412A8 */
        build/native_source/drlg_l2.raw_drlg_l2_rodata_801412a8.rodata.s.o(.rodata);   /* verified native raw span */
        . = 0x76C4;   /* 0x801412BC */
        build/native_source/drlg_l2.raw_drlg_l2_rodata_801412bc.rodata.s.o(.rodata);   /* verified native raw span */
        . = 0x76D8;   /* 0x801412D0 */
        build/native_source/drlg_l2.raw_drlg_l2_rodata_801412d0.rodata.s.o(.rodata);   /* verified native raw span */
        . = 0x76EC;   /* 0x801412E4 */
        build/native_source/drlg_l2.raw_drlg_l2_rodata_801412e4.rodata.s.o(.rodata);   /* verified native raw span */
        . = 0x7700;   /* 0x801412F8 */
        build/native_source/drlg_l2.raw_drlg_l2_rodata_801412f8.rodata.s.o(.rodata);   /* verified native raw span */
        . = 0x7714;   /* 0x8014130C */
        build/native_source/drlg_l2.raw_drlg_l2_rodata_8014130c.rodata.s.o(.rodata);   /* verified native raw span */
        . = 0x7728;   /* 0x80141320 */
        build/native_source/drlg_l2.raw_drlg_l2_rodata_80141320.rodata.s.o(.rodata);   /* verified native raw span */
        . = 0x773C;   /* 0x80141334 */
        build/native_source/drlg_l2.raw_drlg_l2_rodata_80141334.rodata.s.o(.rodata);   /* verified native raw span */
        . = 0x7750;   /* 0x80141348 */
        build/native_source/drlg_l2.raw_drlg_l2_rodata_80141348.rodata.s.o(.rodata);   /* verified native raw span */
        . = 0x7764;   /* 0x8014135C */
        build/native_source/drlg_l2.raw_drlg_l2_rodata_8014135c.rodata.s.o(.rodata);   /* verified native raw span */
        . = 0x7778;   /* 0x80141370 */
        build/native_source/drlg_l2.raw_drlg_l2_rodata_80141370.rodata.s.o(.rodata);   /* verified native raw span */
        . = 0x778C;   /* 0x80141384 */
        build/native_source/drlg_l2.raw_drlg_l2_rodata_80141384.rodata.s.o(.rodata);   /* verified native raw span */
        . = 0x779C;   /* 0x80141394 */
        build/native_source/drlg_l2.raw_drlg_l2_rodata_80141394.rodata.s.o(.rodata);   /* verified native raw span */
        . = 0x77AC;   /* 0x801413A4 */
        build/native_source/drlg_l2.raw_drlg_l2_rodata_801413a4.rodata.s.o(.rodata);   /* verified native raw span */
        . = 0x77BC;   /* 0x801413B4 */
        build/native_source/drlg_l2.raw_drlg_l2_rodata_801413b4.rodata.s.o(.rodata);   /* verified native raw span */
        . = 0x77CC;   /* 0x801413C4 */
        build/native_source/drlg_l2.raw_drlg_l2_rodata_801413c4.rodata.s.o(.rodata);   /* verified native raw span */
        . = 0x77DC;   /* 0x801413D4 */
        build/native_source/drlg_l2.raw_drlg_l2_rodata_801413d4.rodata.s.o(.rodata);   /* verified native raw span */
        . = 0x77EC;   /* 0x801413E4 */
        build/native_source/drlg_l2.raw_drlg_l2_rodata_801413e4.rodata.s.o(.rodata);   /* verified native raw span */
        . = 0x77FC;   /* 0x801413F4 */
        build/native_source/drlg_l2.raw_drlg_l2_rodata_801413f4.rodata.s.o(.rodata);   /* verified native raw span */
        . = 0x780C;   /* 0x80141404 */
        build/native_source/drlg_l2.raw_drlg_l2_rodata_80141404.rodata.s.o(.rodata);   /* verified native raw span */
        . = 0x781C;   /* 0x80141414 */
        build/native_source/drlg_l2.raw_drlg_l2_rodata_80141414.rodata.s.o(.rodata);   /* verified native raw span */
        . = 0x782C;   /* 0x80141424 */
        build/native_source/drlg_l2.raw_drlg_l2_rodata_80141424.rodata.s.o(.rodata);   /* verified native raw span */
        . = 0x783C;   /* 0x80141434 */
        build/native_source/drlg_l2.raw_drlg_l2_rodata_80141434.rodata.s.o(.rodata);   /* verified native raw span */
        . = 0x784C;   /* 0x80141444 */
        build/native_source/drlg_l2.raw_drlg_l2_rodata_80141444.rodata.s.o(.rodata);   /* verified native raw span */
        . = 0x785C;   /* 0x80141454 */
        build/native_source/drlg_l2.raw_drlg_l2_rodata_80141454.rodata.s.o(.rodata);   /* verified native raw span */
        . = 0x786C;   /* 0x80141464 */
        build/native_source/drlg_l2.raw_drlg_l2_rodata_80141464.rodata.s.o(.rodata);   /* verified native raw span */
        . = 0x787C;   /* 0x80141474 */
        build/native_source/drlg_l2.raw_drlg_l2_rodata_80141474.rodata.s.o(.rodata);   /* verified native raw span */
        . = 0x788C;   /* 0x80141484 */
        build/native_source/drlg_l2.raw_drlg_l2_rodata_80141484.rodata.s.o(.rodata);   /* verified native raw span */
        . = 0x789C;   /* 0x80141494 */
        build/native_source/drlg_l2.raw_drlg_l2_rodata_80141494.rodata.s.o(.rodata);   /* verified native raw span */
        . = 0x78AC;   /* 0x801414A4 */
        build/native_source/drlg_l2.raw_drlg_l2_rodata_801414a4.rodata.s.o(.rodata);   /* verified native raw span */
        . = 0x78BC;   /* 0x801414B4 */
        build/native_source/drlg_l2.raw_drlg_l2_rodata_801414b4.rodata.s.o(.rodata);   /* verified native raw span */
        . = 0x78CC;   /* 0x801414C4 */
        build/native_source/drlg_l2.raw_drlg_l2_rodata_801414c4.rodata.s.o(.rodata);   /* verified native raw span */
        . = 0x78DC;   /* 0x801414D4 */
        build/native_source/drlg_l2.raw_drlg_l2_rodata_801414d4.rodata.s.o(.rodata);   /* verified native raw span */
        . = 0x78EC;   /* 0x801414E4 */
        build/native_source/drlg_l2.raw_drlg_l2_rodata_801414e4.rodata.s.o(.rodata);   /* verified native raw span */
        . = 0x78FC;   /* 0x801414F4 */
        build/native_source/drlg_l2.raw_drlg_l2_rodata_801414f4.rodata.s.o(.rodata);   /* verified native raw span */
        . = 0x790C;   /* 0x80141504 */
        build/native_source/drlg_l2.raw_drlg_l2_rodata_80141504.rodata.s.o(.rodata);   /* verified native raw span */
        . = 0x791C;   /* 0x80141514 */
        build/native_source/drlg_l2.raw_drlg_l2_rodata_80141514.rodata.s.o(.rodata);   /* verified native raw span */
        . = 0x792C;   /* 0x80141524 */
        build/native_source/drlg_l2.raw_drlg_l2_rodata_80141524.rodata.s.o(.rodata);   /* verified native raw span */
        . = 0x793C;   /* 0x80141534 */
        build/native_source/drlg_l2.raw_drlg_l2_rodata_80141534.rodata.s.o(.rodata);   /* verified native raw span */
        . = 0x794C;   /* 0x80141544 */
        build/native_source/drlg_l2.raw_drlg_l2_rodata_80141544.rodata.s.o(.rodata);   /* verified native raw span */
        . = 0x795C;   /* 0x80141554 */
        build/native_source/drlg_l2.raw_drlg_l2_rodata_80141554.rodata.s.o(.rodata);   /* verified native raw span */
        . = 0x796C;   /* 0x80141564 */
        build/native_source/drlg_l2.raw_drlg_l2_rodata_80141564.rodata.s.o(.rodata);   /* verified native raw span */
        . = 0x797C;   /* 0x80141574 */
        build/native_source/drlg_l2.raw_drlg_l2_rodata_80141574.rodata.s.o(.rodata);   /* verified native raw span */
        . = 0x798C;   /* 0x80141584 */
        build/native_source/drlg_l2.raw_drlg_l2_rodata_80141584.rodata.s.o(.rodata);   /* verified native raw span */
        . = 0x799C;   /* 0x80141594 */
        build/native_source/drlg_l2.raw_drlg_l2_rodata_80141594.rodata.s.o(.rodata);   /* verified native raw span */
        . = 0x79AC;   /* 0x801415A4 */
        build/native_source/drlg_l2.raw_drlg_l2_rodata_801415a4.rodata.s.o(.rodata);   /* verified native raw span */
        . = 0x79BC;   /* 0x801415B4 */
        build/native_source/drlg_l2.raw_drlg_l2_rodata_801415b4.rodata.s.o(.rodata);   /* verified native raw span */
        . = 0x79CC;   /* 0x801415C4 */
        build/native_source/drlg_l2.raw_drlg_l2_rodata_801415c4.rodata.s.o(.rodata);   /* verified native raw span */
        . = 0x79DC;   /* 0x801415D4 */
        build/native_source/drlg_l2.raw_drlg_l2_rodata_801415d4.rodata.s.o(.rodata);   /* verified native raw span */
        . = 0x79EC;   /* 0x801415E4 */
        build/native_source/drlg_l2.raw_drlg_l2_rodata_801415e4.rodata.s.o(.rodata);   /* verified native raw span */
        . = 0x79FC;   /* 0x801415F4 */
        build/native_source/drlg_l2.raw_drlg_l2_rodata_801415f4.rodata.s.o(.rodata);   /* verified native raw span */
        . = 0x7A0C;   /* 0x80141604 */
        build/native_source/drlg_l2.raw_drlg_l2_rodata_80141604.rodata.s.o(.rodata);   /* verified native raw span */
        . = 0x7A30;   /* 0x80141628 */
        build/native_source/drlg_l2.raw_drlg_l2_rodata_80141628.rodata.s.o(.rodata);   /* verified native raw span */
        . = 0x7A54;   /* 0x8014164C */
        build/native_source/drlg_l2.raw_drlg_l2_rodata_8014164c.rodata.s.o(.rodata);   /* verified native raw span */
        . = 0x7A78;   /* 0x80141670 */
        build/native_source/drlg_l2.raw_drlg_l2_rodata_80141670.rodata.s.o(.rodata);   /* verified native raw span */
        . = 0x7A98;   /* 0x80141690 */
        build/native_source/drlg_l2.raw_drlg_l2_rodata_80141690.rodata.s.o(.rodata);   /* verified native raw span */
        . = 0x7AA4;   /* 0x8014169C */
        build/native_source/drlg_l2.raw_drlg_l2_rodata_8014169c.rodata.s.o(.rodata);   /* verified native raw span */
        . = 0x7AB0;   /* 0x801416A8 */
        build/native_source/drlg_l2.raw_drlg_l2_rodata_801416a8.rodata.s.o(.rodata);   /* verified native raw span */
        . = 0x7ABC;   /* 0x801416B4 */
        build/native_source/drlg_l2.raw_drlg_l2_rodata_801416b4.rodata.s.o(.rodata);   /* verified native raw span */
        . = 0x7AC8;   /* 0x801416C0 */
        build/native_source/drlg_l2.raw_drlg_l2_rodata_801416c0.rodata.s.o(.rodata);   /* verified native raw span */
        . = 0x7AD4;   /* 0x801416CC */
        build/native_source/drlg_l2.raw_drlg_l2_rodata_801416cc.rodata.s.o(.rodata);   /* verified native raw span */
        . = 0x9810;   /* 0x80143408 */
        build/native_source/drlg_l2.text.s.o(.text);   /* verified native-assembled source */
        . = 0xEAAC;   /* 0x801486A4 */
        build/native_source/drlg_l3_pool.rodata.s.o(.rodata);   /* verified native source data */
        . = 0xEAEC;   /* 0x801486E4 */
        build/native_source/drlg_l3_tables.data.s.o(.data);   /* verified native source data */
        . = 0xF3A0;   /* 0x80148F98 */
        build/native_source/drlg_l3.text.s.o(.text);   /* verified native-assembled source */
        . = 0x13C00;   /* 0x8014D7F8 */
        build/native_source/drlg_l4_pool.rodata.s.o(.rodata);   /* verified native source data */
        . = 0x13C7C;   /* 0x8014D874 */
        build/native_source/drlg_l4_tables.data.s.o(.data);   /* verified native source data */
        . = 0x158B0;   /* 0x8014F4A8 */
        build/native_source/drlg_l4.text.s.o(.text);   /* verified native-assembled source */
        . = 0x1B6E0;   /* 0x801552D8 */
        build/native_source/setmaps.text.s.o(.text);   /* verified native-assembled source */
        . = 0x1BE0C;   /* 0x80155A04 */
        build/native_source/choosem.text.s.o(.text);   /* verified native-assembled source */
        . = 0x1C3E0;   /* 0x80155FD8 */
        build/native_source/preobj.text.s.o(.text);   /* verified native-assembled source */
        . = 0x202E4;   /* 0x80159EDC */
        build/native_source/gendung.text.s.o(.text);   /* verified native-assembled source */
        . = 0x22014;   /* 0x8015BC0C */
        build/native_source/themes.text.s.o(.text);   /* verified native-assembled source */
        . = 0x24B84;   /* 0x8015E77C */
        build/native_source/preport.text.s.o(.text);   /* verified native-assembled source */
        . = 0x24BE4;   /* 0x8015E7DC */
        build/native_source/prequest.text.s.o(.text);   /* verified native-assembled source */
        . = 0x25878;   /* 0x8015F470 */
        build/native_source/preinv.text.s.o(.text);   /* verified native-assembled source */
        . = 0x258CC;   /* 0x8015F4C4 */
        build/native_source/preauto.text.s.o(.text);   /* verified native-assembled source */
        . = 0x25AF0;   /* 0x8015F6E8 */
        build/native_source/premon.text.s.o(.text);   /* verified native-assembled source */
        . = 0x283E4;   /* 0x80161FDC */
        build/native_source/premiss.text.s.o(.text);   /* verified native-assembled source */
        . = 0x285B4;   /* 0x801621AC */
        build/native_source/pretrigs.text.s.o(.text);   /* verified native-assembled source */
        . = 0x290E4;   /* 0x80162CDC */
        build/native_source/prestore.text.s.o(.text);   /* verified native-assembled source */
        . = 0x293DC;   /* 0x80162FD4 */
        build/native_source/premsg.text.s.o(.text);   /* verified native-assembled source */
        . = 0x29DCC;   /* image end 0x801639C4 */
    }
    /DISCARD/ : { *(.reginfo) *(.mdebug*) *(.comment) *(.pdr) *(.gnu.attributes) *(.MIPS.abiflags) }
}
