/* generated by tools/gen_ld.py: true ROM order, every subsegment pinned to its retail address */
SECTIONS
{
    _gp = 0x8011A780;
    __romPos = 0;
    _startup_text_id = 4;   /* PSYLINK group #4 of the retail link order */
    _map_data_id = 5;   /* PSYLINK group #5 of the retail link order */
    _frontend_text_id = 11;   /* PSYLINK group #11 of the retail link order */
    _pregame_text_id = 12;   /* PSYLINK group #12 of the retail link order */
    _game_text_id = 13;   /* PSYLINK group #13 of the retail link order */
    _fmv_text_id = 14;   /* PSYLINK group #14 of the retail link order */
    .game 0x80139BF8 : AT(0) SUBALIGN(4)
    {
        . = 0x0;   /* 0x80139BF8 */
        LONG(_game_text_id);   /* PSYLINK $game_text overlay-id word */
        . = 0x4;   /* 0x80139BFC */
        build/native_source/gameonly.text.s.o(.text);   /* verified native-assembled source */
        . = 0xC;   /* 0x80139C04 */
        build/native_source/missiles.text.s.o(.text);   /* verified native-assembled source */
        . = 0x10F7C;   /* 0x8014AB74 */
        build/native_source/monster.text.s.o(.text);   /* verified native-assembled source */
        . = 0x1D67C;   /* 0x80157274 */
        build/native_source/inv.text.s.o(.text);   /* verified native-assembled source */
        . = 0x28360;   /* 0x80161F58 */
        build/native_source/automap.text.s.o(.text);   /* verified native-assembled source */
        . = 0x2A228;   /* image end 0x80163E20 */
    }
    /DISCARD/ : { *(.reginfo) *(.mdebug*) *(.comment) *(.pdr) *(.gnu.attributes) *(.MIPS.abiflags) }
}
