/* generated by tools/gen_ld.py: true ROM order, every subsegment pinned to its retail address */
SECTIONS
{
    _gp = 0x8011A780;
    __romPos = 0;
    _startup_text_id = 4;   /* PSYLINK group #4 of the retail link order */
    _map_data_id = 5;   /* PSYLINK group #5 of the retail link order */
    _frontend_text_id = 11;   /* PSYLINK group #11 of the retail link order */
    _pregame_text_id = 12;   /* PSYLINK group #12 of the retail link order */
    _game_text_id = 13;   /* PSYLINK group #13 of the retail link order */
    _fmv_text_id = 14;   /* PSYLINK group #14 of the retail link order */
    .frontend 0x80139BF8 : AT(0) SUBALIGN(4)
    {
        . = 0x0;   /* 0x80139BF8 */
        LONG(_frontend_text_id);   /* PSYLINK $frontend_text overlay-id word */
        . = 0x4;   /* 0x80139BFC */
        build/native_source/presonly.text.s.o(.text);   /* verified native-assembled source */
        . = 0x2C;   /* 0x80139C24 */
        build/native_source/fe.text.s.o(.text);   /* verified native-assembled source */
        . = 0x2F58;   /* 0x8013CB50 */
        build/native_source/credits_rodata_8013cb50.rodata.s.o(.rodata);   /* verified native source data */
        . = 0x35BC;   /* 0x8013D1B4 */
        build/native_source/credits.text.s.o(.text);   /* verified native-assembled source */
        . = 0x4560;   /* 0x8013E158 */
        build/native_source/memcard_rodata_8013e158.rodata.s.o(.rodata);   /* verified native source data */
        . = 0x8B00;   /* 0x801426F8 */
        build/native_source/memcard.text.s.o(.text);   /* verified native-assembled source */
        . = 0x99F0;   /* 0x801435E8 */
        build/native_source/dlg_rodata_801435e8.rodata.s.o(.rodata);   /* verified native source data */
        . = 0x9A0C;   /* 0x80143604 */
        build/native_source/dlg_2.raw_dlg.c.s.o(.text);   /* verified native raw segment */
        . = 0x9A54;   /* 0x8014364C */
        build/native_source/dlg_rodata_8014364c.rodata.s.o(.rodata);   /* verified native source data */
        . = 0x9AA8;   /* 0x801436A0 */
        build/native_source/dlg_2.raw_dlg_1.c.s.o(.text);   /* verified native raw segment */
        . = 0x9AF4;   /* 0x801436EC */
        build/native_source/dlg_rodata_801436ec.rodata.s.o(.rodata);   /* verified native source data */
        . = 0x1F998;   /* 0x80159590 */
        build/native_source/dlg_2.text.s.o(.text);   /* verified native-assembled source */
        . = 0x21D60;   /* 0x8015B958 */
        build/native_source/loadsave.text.s.o(.text);   /* verified native-assembled source */
        . = 0x23234;   /* image end 0x8015CE2C */
    }
    /DISCARD/ : { *(.reginfo) *(.mdebug*) *(.comment) *(.pdr) *(.gnu.attributes) *(.MIPS.abiflags) }
}
